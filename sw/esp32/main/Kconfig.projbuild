## sw/esp32/main/Kconfig.projbuild
```kconfig
menu "Project Configuration"

    config WIFI_SSID
        string "WiFi SSID"
        default "mywifissid"
        help
            SSID of network to connect to.

    config WIFI_PASSWORD
        string "WiFi Password"
        default "mypassword"
        help
            WiFi password (WPA or WPA2) of the network to connect to.

    config SMARTBULB_MAC_ADDRESS
        string "Smartbulb MAC address"
        default "00:00:00:00:00:00"
        help
            MAC address of the Bluetooth Low Energy (BLE) smartbulb to connect to.

endmenu
```
